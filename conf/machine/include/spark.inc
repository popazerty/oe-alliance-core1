## conf/machine/include/spark.inc
```bitbake
require conf/machine/include/tune-sh4.inc

BRAND_OEM = "spark"
MACHINE_BRAND = "Spark"
TARGET_ARCH = "sh4"
STLINUX_SH_UPD_SRPMS = "http://ftp.stlinux.com/pub/stlinux/2.4/updates/SRPMS"
STLINUX_SH_UPD_RPMS = "http://ftp.stlinux.com/pub/stlinux/2.4/updates/RPMS/sh4/"
STM_PATCH_STR ??= "0212"
LINUX_VERSION ??= "2.6.32.61"

GCCVERSION = "4.7%"

PREFERRED_PROVIDER_virtual/kernel = "stlinux24-${MACHINE}"
PREFERRED_VERSION_stlinux24-${MACHINE} = "${LINUX_VERSION}-stm24-${STM_PATCH_STR}"
PREFERRED_VERSION_linux-libc-headers = "2.6.32"
PREFERRED_PROVIDER_showiframe = "tdt-utils-${MACHINE}"
PREFERRED_PROVIDER_directfb = "stm-directfb"

USE_VT = "0"
MACHINE_FEATURES = "kernel26 ext2 alsa usbhost serial"

SERIAL_CONSOLE = "115200 ttyAS0"

KERNEL_IMAGETYPE = "uImage"

# save some extra space, kernel has its own mtd partion 
RDEPENDS_kernel-base = ""

UBI_VOLNAME = "rootfs"
MKUBIFS_ARGS = "-m 2048 -e 129024 -c 638   -F"
UBINIZE_ARGS = "-m 2048 -p 128KiB -O 512"

JFFS2_ERASEBLOCK = "0x20000"
JFFS2_ENDIANNESS = "${@base_conditional('SITEINFO_ENDIANNESS', 'le', '--little-endian', '--big-endian', d)}"
EXTRA_IMAGECMD_jffs2 = "--pad ${JFFS2_ENDIANNESS} --eraseblock=${JFFS2_ERASEBLOCK} --no-cleanmarkers"

INHERIT += "usb_image-spark71xx"
IMAGE_FSTYPES ?= "tar.gz ubi ${SDIMG_ROOTFS_TYPE} jffs2 spark71xx-usbimg"

IMAGE_CLASSES += "usb_image-spark71xx"
INITRAMFS_FSTYPES = "ext2.gz spark-updt"

MACHINE_EXTRA_RRECOMMENDS = "kernel-modules"

MACHINE_ESSENTIAL_EXTRA_RDEPENDS += " \
    stlinux24-sh4-stx7111-fdma-firmware \
    stlinux24-sh4-stmfb-firmware-stx7111 \
    stslave-fw \
    lirc \
    lrzsz \
    mtd-utils \
    mtd-utils-jffs2 \
    mtd-utils-ubifs \
    mtd-utils-misc \
    tdt-utils-${MACHINE} \
    tdt-dvb-modules-${MACHINE} \
    "

MACHINE_EXTRA_RRECOMMENDS = " \
    tdt-gst-plugin-dvbmediasink \
    "

#EGLIBCVERSION ?= "2.17"
OLDEST_KERNEL = "2.6.32"
```

## meta-brands/meta-fulan/conf/machine/include/oem-fulan.inc
```bitbake
# We know about rtc
include conf/machine/include/build-extras.inc

BRAND_OEM = "fulan"

MACHINE_NAME = "\
${@base_contains('MACHINEBUILD', 'amiko8900', 'SHD-8900 Alien' , '', d)}\
${@base_contains('MACHINEBUILD', 'sognorevolution', 'Spark Revolution' , '', d)}\
${@base_contains('MACHINEBUILD', 'arguspingulux', 'pingulux' , '', d)}\
${@base_contains('MACHINEBUILD', 'sparktriplex', 'SPARK TRIPLEX'  , '', d)}\
${@base_contains('MACHINEBUILD', 'sparkreloaded', 'SPARK RELOADED'  , '', d)}\
${@base_contains('MACHINEBUILD', 'amikoalien', 'Alien 2' , '', d)}\
${@base_contains('MACHINEBUILD', 'sognotriple', 'Spark Triple' , '', d)}\
"

MACHINE_BRAND = "\
${@base_contains('MACHINEBUILD', 'amiko8900', 'Amiko' , '', d)}\
${@base_contains('MACHINEBUILD', 'sognorevolution', 'SOGNO' , '', d)}\
${@base_contains('MACHINEBUILD', 'arguspingulux', 'argus' , '', d)}\
${@base_contains('MACHINEBUILD', 'sparktriplex', 'GOLDEN MEDIA'  , '', d)}\
${@base_contains('MACHINEBUILD', 'sparkreloaded', 'GOLDEN MEDIA'  , '', d)}\
${@base_contains('MACHINEBUILD', 'amikoalien', 'Amiko' , '', d)}\
${@base_contains('MACHINEBUILD', 'sognotriple', 'SOGNO' , '', d)}\
"

IMAGEDIR ?= "\
${@base_contains('MACHINEBUILD', 'amiko8900', 'enigma2' , '', d)}\
${@base_contains('MACHINEBUILD', 'sognorevolution', 'enigma2' , '', d)}\
${@base_contains('MACHINEBUILD', 'arguspingulux', 'enigma2' , '', d)}\
${@base_contains('MACHINEBUILD', 'sparktriplex', 'enigma2'  , '', d)}\
${@base_contains('MACHINEBUILD', 'sparkreloaded', 'enigma2'  , '', d)}\
${@base_contains('MACHINEBUILD', 'amikoalien', 'enigma2' , '', d)}\
${@base_contains('MACHINEBUILD', 'sognotriple', 'enigma2' , '', d)}\
"

MTD_KERNEL = "\
${@base_contains('MACHINEBUILD', 'amiko8900', 'mtd5' , '', d)}\
${@base_contains('MACHINEBUILD', 'sognorevolution', 'mtd5' , '', d)}\
${@base_contains('MACHINEBUILD', 'arguspingulux', 'mtd5' , '', d)}\
${@base_contains('MACHINEBUILD', 'sparktriplex', 'mtd5'  , '', d)}\
${@base_contains('MACHINEBUILD', 'sparkreloaded', 'mtd5'  , '', d)}\
${@base_contains('MACHINEBUILD', 'amikoalien', 'mtd5' , '', d)}\
${@base_contains('MACHINEBUILD', 'sognotriple', 'mtd5' , '', d)}\
"

MTD_ROOTFS = "\
${@base_contains('MACHINEBUILD', 'amiko8900', 'mtd6' , '', d)}\
${@base_contains('MACHINEBUILD', 'sognorevolution', 'mtd6' , '', d)}\
${@base_contains('MACHINEBUILD', 'arguspingulux', 'mtd6' , '', d)}\
${@base_contains('MACHINEBUILD', 'sparktriplex', 'mtd6'  , '', d)}\
${@base_contains('MACHINEBUILD', 'sparkreloaded', 'mtd6'  , '', d)}\
${@base_contains('MACHINEBUILD', 'amikoalien', 'mtd6' , '', d)}\
${@base_contains('MACHINEBUILD', 'sognotriple', 'mtd6' , '', d)}\
"

KERNEL_FILE = "uImage"
ROOTFS_FILE = "e2jffs2.img"

TARGET_ARCH = "sh4"
STLINUX_SH_UPD_SRPMS = "http://ftp.stlinux.com/pub/stlinux/2.4/updates/SRPMS"
STLINUX_SH_UPD_RPMS = "http://ftp.stlinux.com/pub/stlinux/2.4/updates/RPMS/sh4/"

GCCVERSION = "4.8%"

PREFERRED_PROVIDER_virtual/kernel = "linux-stm"
PREFERRED_VERSION_linux-libc-headers = "2.6.32"
PREFERRED_PROVIDER_directfb = "stm-directfb"
SERIAL_CONSOLE = "115200 ttyAS0"

DVBPROVIDER = "kernel"

USE_VT = "0"
MACHINE_FEATURES = "3dtv alsa hdmicec switchoff wifi kernel26 ext2 usbhost serial dvb-c singlecore"

KERNEL_IMAGETYPE = "uImage"

# save some extra space, kernel has its own mtd partion 
RDEPENDS_kernel-base = ""

JFFS2_ERASEBLOCK = "0x20000"
JFFS2_ENDIANNESS = "${@base_conditional('SITEINFO_ENDIANNESS', 'le', '--little-endian', '--big-endian', d)}"
EXTRA_IMAGECMD_jffs2 = "--pad ${JFFS2_ENDIANNESS} --eraseblock=${JFFS2_ERASEBLOCK} --no-cleanmarkers"

IMAGE_FSTYPES ?= "jffs2"

# enable this for debug
#IMAGE_FSTYPES += "tar.gz spark71xx-usbimg"
#INHERIT += "usb_image-spark71xx"

IMAGE_CLASSES += "usb_image-spark71xx"
INITRAMFS_FSTYPES = "ext2.gz spark-updt"

IMAGE_CMD_jffs2_append = " ; \
    mkdir -p ${DEPLOY_DIR_IMAGE}/${IMAGEDIR}; \
    mv ${DEPLOY_DIR_IMAGE}/${IMAGE_NAME}.rootfs.jffs2 ${DEPLOY_DIR_IMAGE}/${IMAGEDIR}/${ROOTFS_FILE}; \
    cp ${DEPLOY_DIR_IMAGE}/uImage ${DEPLOY_DIR_IMAGE}/${IMAGEDIR}/${KERNEL_FILE}; \
    cd ${DEPLOY_DIR_IMAGE}; \
    zip ${IMAGE_NAME}_usb.zip ${IMAGEDIR}/*; \
    rm -f ${DEPLOY_DIR_IMAGE}/*.jffs2; \
    rm -f ${DEPLOY_DIR_IMAGE}/*.manifest; \
    rm -f ${DEPLOY_DIR_IMAGE}/.jffs2; \
    rm -f ${DEPLOY_DIR_IMAGE}/.manifest; \
    rm -rf ${IMAGEDIR}; \
    "
	
MACHINE_EXTRA_RRECOMMENDS = "kernel-modules"

MACHINE_ESSENTIAL_EXTRA_RDEPENDS += " \
    stlinux24-sh4-stx7111-fdma-firmware \
    stlinux24-sh4-stmfb-firmware-stx7111 \
    stslave-fw \
    ustslave \
    lirc \
    fulan-dvb-modules \
    "

MACHINE_EXTRA_RRECOMMENDS = " \
    tdt-gst-plugin-dvbmediasink \
    "

OLDEST_KERNEL = "2.6.32"

include conf/machine/include/autoload-filesystems.inc

require conf/machine/include/tune-sh4.inc

# add support for extra feeds
PACKAGE_ARCHS += " ${MACHINEBUILD}"
```

## meta-brands/meta-spark/conf/layer.conf
```bitbake
# We have a conf and classes directory, append to BBPATH
BBPATH .= ":${LAYERDIR}"

# We have a recipes directory, add to BBFILES
BBFILES += "${LAYERDIR}/recipes-*/*.bb ${LAYERDIR}/recipes-*/*.bbappend \
            ${LAYERDIR}/recipes-*/*/*.bb ${LAYERDIR}/recipes-*/*/*.bbappend"

BBFILE_COLLECTIONS += "spark-layer"
BBFILE_PATTERN_spark-layer := "^${LAYERDIR}/"
BBFILE_PRIORITY_spark-layer = "7"

OEA-META-SPARK-BASE := '${@os.path.normpath("${LAYERDIR}/../")}'
```

## meta-brands/meta-spark/conf/machine/include/spark.inc
```bitbake
require conf/machine/include/tune-sh4.inc

BRAND_OEM = "spark"
MACHINE_BRAND = "Spark"
TARGET_ARCH = "sh4"
STLINUX_SH_UPD_SRPMS = "http://ftp.stlinux.com/pub/stlinux/2.4/updates/SRPMS"
STLINUX_SH_UPD_RPMS = "http://ftp.stlinux.com/pub/stlinux/2.4/updates/RPMS/sh4/"

GCCVERSION = "4.8%"

PREFERRED_PROVIDER_virtual/kernel = "linux-stm"
PREFERRED_VERSION_linux-libc-headers = "2.6.32"
PREFERRED_PROVIDER_directfb = "stm-directfb"

USE_VT = "0"
MACHINE_FEATURES = "kernel26 ext2 alsa usbhost serial"

SERIAL_CONSOLE = "115200 ttyAS0"

KERNEL_IMAGETYPE = "uImage"

# save some extra space, kernel has its own mtd partion 
RDEPENDS_kernel-base = ""

UBI_VOLNAME = "rootfs"
MKUBIFS_ARGS = "-m 2048 -e 129024 -c 638   -F"
UBINIZE_ARGS = "-m 2048 -p 128KiB -O 512"

JFFS2_ERASEBLOCK = "0x20000"
JFFS2_ENDIANNESS = "${@base_conditional('SITEINFO_ENDIANNESS', 'le', '--little-endian', '--big-endian', d)}"
EXTRA_IMAGECMD_jffs2 = "--pad ${JFFS2_ENDIANNESS} --eraseblock=${JFFS2_ERASEBLOCK} --no-cleanmarkers"

INHERIT += "usb_image-spark71xx"
IMAGE_FSTYPES ?= "tar.gz jffs2 spark71xx-usbimg"

IMAGE_CLASSES += "usb_image-spark71xx"
INITRAMFS_FSTYPES = "ext2.gz spark-updt"

IMAGE_CMD_prepend = " \
    rm -rf ${DEPLOY_DIR_IMAGE}/.jffs2; \
    rm -rf ${DEPLOY_DIR_IMAGE}/.tar.gz; \
    rm -rf ${DEPLOY_DIR_IMAGE}/.spark71xx-usbimg; \
    rm -rf ${DEPLOY_DIR_IMAGE}/.manifest; \
    "

IMAGE_CMD_jffs2_append = " \
    mkdir -p ${DEPLOY_DIR_IMAGE}/enigma2; \
    cp ${DEPLOY_DIR_IMAGE}/${IMAGE_NAME}.rootfs.jffs2 ${DEPLOY_DIR_IMAGE}/enigma2/e2jffs2.img; \
    cp ${DEPLOY_DIR_IMAGE}/uImage ${DEPLOY_DIR_IMAGE}/enigma2/uImage; \
    cd ${DEPLOY_DIR_IMAGE}; \
    zip ${IMAGE_NAME}_usb.zip enigma2; \
    rm -rf enigma2; \
    "

MACHINE_EXTRA_RRECOMMENDS = "kernel-modules"

MACHINE_ESSENTIAL_EXTRA_RDEPENDS += " \
    stlinux24-sh4-stx7111-fdma-firmware \
    stlinux24-sh4-stmfb-firmware-stx7111 \
    stslave-fw \
    lirc \
    tdt-utils \
    spark-dvb-modules \
    "

MACHINE_EXTRA_RRECOMMENDS = " \
    tdt-gst-plugin-dvbmediasink \
    "

OLDEST_KERNEL = "2.6.32"
```

## meta-oe/conf/machine/include/spark.inc
```bitbake
require conf/machine/include/tune-sh4.inc

BRAND_OEM = "spark"
MACHINE_BRAND = "Spark"
TARGET_ARCH = "sh4"
STLINUX_SH_UPD_SRPMS = "http://ftp.stlinux.com/pub/stlinux/2.4/updates/SRPMS"
STLINUX_SH_UPD_RPMS = "http://ftp.stlinux.com/pub/stlinux/2.4/updates/RPMS/sh4/"

#GCCVERSION = "4.8%"

PREFERRED_PROVIDER_virtual/kernel = "linux-stm"
PREFERRED_VERSION_linux-libc-headers = "2.6.32"
#PREFERRED_PROVIDER_showiframe = "tdt-utils-${MACHINE}"
PREFERRED_PROVIDER_showiframe = "showiframe"
PREFERRED_PROVIDER_directfb = "stm-directfb"

USE_VT = "0"
MACHINE_FEATURES = "kernel26 ext2 alsa usbhost serial"

SERIAL_CONSOLE = "115200 ttyAS0"

KERNEL_IMAGETYPE = "uImage"

# save some extra space, kernel has its own mtd partion 
RDEPENDS_kernel-base = ""

UBI_VOLNAME = "rootfs"
MKUBIFS_ARGS = "-m 2048 -e 129024 -c 638   -F"
UBINIZE_ARGS = "-m 2048 -p 128KiB -O 512"

JFFS2_ERASEBLOCK = "0x20000"
JFFS2_ENDIANNESS = "${@base_conditional('SITEINFO_ENDIANNESS', 'le', '--little-endian', '--big-endian', d)}"
EXTRA_IMAGECMD_jffs2 = "--pad ${JFFS2_ENDIANNESS} --eraseblock=${JFFS2_ERASEBLOCK} --no-cleanmarkers"

INHERIT += "usb_image-spark71xx"
IMAGE_FSTYPES ?= "tar.gz jffs2 spark71xx-usbimg"

IMAGE_CLASSES += "usb_image-spark71xx"
INITRAMFS_FSTYPES = "ext2.gz spark-updt"

MACHINE_EXTRA_RRECOMMENDS = "kernel-modules"

MACHINE_ESSENTIAL_EXTRA_RDEPENDS += " \
    stlinux24-sh4-stx7111-fdma-firmware \
    stlinux24-sh4-stmfb-firmware-stx7111 \
    stslave-fw \
    lirc \
    tdt-utils-${MACHINE} \
    tdt-dvb-modules-${MACHINE} \
    "

MACHINE_EXTRA_RRECOMMENDS = " \
    tdt-gst-plugin-dvbmediasink \
    "

#EGLIBCVERSION ?= "2.19"
OLDEST_KERNEL = "2.6.32"
```
